## conexio_board_root/boards/conexio/conexio_stratus_pro/board.yml
```yaml
board:
  name: conexio_stratus_pro
  full_name: Conexio Stratus Pro
  vendor: conexio
  socs:
  - name: nrf9161
    variants:
    - name: ns
```

## conexio_board_root_v3/boards/conexio/conexio_stratus_pro/Kconfig.conexio_stratus_pro
```kconfig
# Conexio Stratus Pro board configuration

# SPDX-License-Identifier: Apache-2.0

config BOARD_CONEXIO_STRATUS_PRO
	select SOC_NRF9161_LACA
```

## conexio_board_root_v3/boards/conexio/conexio_stratus_pro/Kconfig.defconfig
```kconfig
# Conexio Stratus Pro board configuration

# SPDX-License-Identifier: Apache-2.0

config HW_STACK_PROTECTION
	default ARCH_HAS_STACK_PROTECTION

if BOARD_CONEXIO_STRATUS_PRO_NRF9160 || BOARD_CONEXIO_STRATUS_PRO_NRF9160_NS

config BOARD_CONEXIO_STRATUS_PRO
	select USE_DT_CODE_PARTITION if BOARD_CONEXIO_STRATUS_PRO_NRF9160_NS

config BOOTLOADER_MCUBOOT
	default y if !MCUBOOT

# Workaround for not being able to have commas in macro arguments.
DT_CHOSEN_Z_CODE_PARTITION := zephyr,code-partition

config FLASH_LOAD_SIZE
	default $(dt_chosen_reg_size_hex,$(DT_CHOSEN_Z_CODE_PARTITION))
	depends on BOARD_CONEXIO_STRATUS_PRO_NRF9160 && TRUSTED_EXECUTION_SECURE

if BOARD_CONEXIO_STRATUS_PRO_NRF9160_NS

config FLASH_LOAD_OFFSET
	default $(dt_chosen_reg_addr_hex,$(DT_CHOSEN_Z_CODE_PARTITION))

config FLASH_LOAD_SIZE
	default $(dt_chosen_reg_size_hex,$(DT_CHOSEN_Z_CODE_PARTITION))

endif # BOARD_CONEXIO_STRATUS_PRO_NRF9160_NS

endif # BOARD_CONEXIO_STRATUS_PRO_NRF9160 || BOARD_CONEXIO_STRATUS_PRO_NRF9160_NS
```

## conexio_board_root_v3/boards/conexio/conexio_stratus_pro/board.yml
```yaml
board:
  name: conexio_stratus_pro
  full_name: Conexio Stratus Pro
  vendor: conexio
  socs:
  - name: nrf9160
    variants:
    - name: ns
```

## conexio_board_root_v3/boards/conexio/conexio_stratus_pro/conexio_stratus_pro_nrf9161_defconfig
```kconfig
# SPDX-License-Identifier: Apache-2.0

# Enable MPU
CONFIG_ARM_MPU=y

# Enable hardware stack protection
CONFIG_HW_STACK_PROTECTION=y

# Enable GPIO
CONFIG_GPIO=y

# Enable UART driver
CONFIG_SERIAL=y

# Enable console
CONFIG_CONSOLE=y
CONFIG_UART_CONSOLE=y

CONFIG_PINCTRL=y

# Enable PMIC
CONFIG_I2C=y
CONFIG_REGULATOR=y
CONFIG_SENSOR=y
CONFIG_NPM13XX_CHARGER=y
```
